## west.yml
```yaml
manifest:
  remotes:
    - name: zagerx
      url-base: https://github.com/zagerx
  
  projects:
    - name: CommonLibrary
      path: syrius-apps/apps/CommonLibrary/
      remote: zagerx
      revision: master

    - name: ProtocolV4
      path: syrius-apps/apps/CommonLibrary/ProtocolV4
      remote: zagerx
      revision: master      
```
